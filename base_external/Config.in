## base_external/Config.in
```kconfig
menu "Whiteboard Wiper External Packages"

source "$BR2_EXTERNAL_PROJECT_BASE_PATH/package/gpio_test/Config.in"
source "$BR2_EXTERNAL_PROJECT_BASE_PATH/package/libdriver_hcsr04/Config.in"
source "$BR2_EXTERNAL_PROJECT_BASE_PATH/package/hcsr04_test/Config.in"
source "$BR2_EXTERNAL_PROJECT_BASE_PATH/package/whiteboard_wiper/Config.in"

endmenu
```

## base_external/package/gpio_test/Config.in
```kconfig
config BR2_PACKAGE_GPIO_TEST
	bool "gpio_test"
	depends on BR2_PACKAGE_LIBGPIOD2
	help
	  A simple GPIO test module
```

## base_external/package/hcsr04_test/Config.in
```kconfig
config BR2_PACKAGE_HCSR04_TEST
	bool "hcsr04_test"
	depends on BR2_PACKAGE_LIBGPIOD2
	depends on BR2_PACKAGE_LIBDRIVER_HCSR04
	help
	  A simple hcsr04 test module
```

## base_external/package/libdriver_hcsr04/Config.in
```kconfig
config BR2_PACKAGE_LIBDRIVER_HCSR04
    bool "libdriver_hcsr04"
    help
      Full‑function MIT‑licensed driver from libdriver.com
```

## base_external/package/whiteboard_wiper/Config.in
```kconfig
config BR2_PACKAGE_WHITEBOARD_WIPER
	bool "whiteboard_wiper"
	depends on BR2_PACKAGE_LIBGPIOD2
	depends on BR2_PACKAGE_LIBDRIVER_HCSR04
	help
        A whiteboard wiping, ass kicking, name taking, robot
```
